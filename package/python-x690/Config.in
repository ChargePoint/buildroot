## package/python-x690/Config.in
```kconfig
config BR2_PACKAGE_PYTHON_X690
	bool "python-x690"
	select BR2_PACKAGE_PYTHON_T61CODEC #runtime
	help
	  Package contains a pure Python implementation of the “x690” standard for BER encoding/decoding.

	  https://pypi.org/project/x690/
```

## package/python-zeep/Config.in
```kconfig
config BR2_PACKAGE_PYTHON_ZEEP
	bool "python-zeep"
	select BR2_PACKAGE_PYTHON_LXML
	select BR2_PACKAGE_PYTHON_ATTRS
	select BR2_PACKAGE_PYTHON_DEFUSEDXML
	select BR2_PACKAGE_PYTHON_CACHED_PROPERTY
	select BR2_PACKAGE_PYTHON_ISODATE
	select BR2_PACKAGE_PYTHON_PYTZ
	help
	  zeep python module

	  https://pypi.org/project/zeep/
```

## package/qt5/qt5webglplugin/Config.in
```kconfig
config BR2_PACKAGE_QT5WEBGLPLUGIN
	bool "qt5webglplugin"
	select BR2_PACKAGE_QT5DECLARATIVE
	select BR2_PACKAGE_QT5WEBSOCKETS
	help
	  Qt is a cross-platform application and UI framework for
	  developers using C++.

	  This package corresponds to the qt5webgl plugin module.

	  https://doc.qt.io/qt-5/webgl.html
```

## package/raw2rgbpnm/Config.in
```kconfig
config BR2_PACKAGE_RAW2RGBPNM
	bool "raw2rgbpnm"
	select BR2_PACKAGE_LIBPNG
	help
	  Convert raw Bayer images to netpbm format
```

## package/sdbus-cpp/Config.in
```kconfig
config BR2_PACKAGE_SDBUS_CPP
	bool "sdbus-c++"
	depends on BR2_INSTALL_LIBSTDCPP
	depends on BR2_PACKAGE_SYSTEMD
	depends on BR2_TOOLCHAIN_GCC_AT_LEAST_7 # C++17
	help
	  sdbus-c++ is a high-level C++ D-Bus library for
	  Linux designed to provide expressive, easy-to-use
	  API using modern C++ '17.

	  This package optionally builds the sdbus-c++-xml2cpp
	  stub code generator for generating the adaptor and
	  proxy interfaces from D-Bus IDL.

	  https://github.com/Kistler-Group/sdbus-cpp

comment "sdbus-c++ needs systemd and a toolchain w/ C++, gcc >= 7"
	depends on !BR2_PACKAGE_SYSTEMD || !BR2_INSTALL_LIBSTDCPP || \
		!BR2_TOOLCHAIN_GCC_AT_LEAST_7
```

## package/sdbus-cpp/Config.in.host
```kconfig
config BR2_PACKAGE_HOST_SDBUS_CPP
	bool "sdbus-c++-xml2cpp"
	depends on BR2_INSTALL_LIBSTDCPP
	depends on BR2_PACKAGE_HOST_SYSTEMD
	select BR2_PACKAGE_HOST_PKGCONF
	help
	  sdbus-c++ is a high-level C++ D-Bus library for
	  Linux designed to provide expressive, easy-to-use
	  API using modern C++ '17.

	  This option enables the sdbus-c++-xml2cpp stub code
	  generator for generating the adaptor and proxy
	  interfaces from D-Bus IDL.

	  https://github.com/Kistler-Group/sdbus-cpp
```

## package/tensorflow/Config.in
```kconfig
config BR2_PACKAGE_TENSORFLOW
    bool "Install TensorFlow Lite"
    help
      TFL aka TensorFlow Lite is an open source deep learning framework for on-device inference. 

      https://www.tensorflow.org/lite
```
