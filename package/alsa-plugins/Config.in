## package/alsa-plugins/Config.in
```kconfig
config BR2_PACKAGE_ALSA_PLUGINS
	bool "alsa-plugins"
	depends on BR2_PACKAGE_ALSA_LIB
	select BR2_PACKAGE_ALSA_LIB_HWDEP
	select BR2_PACKAGE_LIBSAMPLERATE
	help
	  Advanced Linux Sound Architecture Plugins

	  http://www.alsa-project.org/
```

## package/freescale-imx/firmware-sentinel/Config.in
```kconfig
config BR2_PACKAGE_FIRMWARE_SENTINEL
	bool "firmware-sentinel"
	depends on BR2_PACKAGE_FREESCALE_IMX_PLATFORM_IMX93
	help
	  i.MX Sentinel firmware

	  This library is provided by Freescale as-is and doesn't have
	  an upstream.

if BR2_PACKAGE_FIRMWARE_SENTINEL

choice
	prompt "i.MX Sentinel Firmware Release"
	default BR2_PACKAGE_FIRMWARE_SENTINEL_MX93A0 if BR2_PACKAGE_FREESCALE_IMX_PLATFORM_IMX93
	help
	  Select the appropriate ahab container image to install
	  to match the iMX asics revision.

	  Note - mismatches result in a failure to boot

config BR2_PACKAGE_FIRMWARE_SENTINEL_MX93A0
	bool "imx-seco-mx93a0"
	depends on BR2_PACKAGE_FREESCALE_IMX_PLATFORM_IMX93

endchoice

config BR2_PACKAGE_FIRMWARE_SENTINEL_AHAB_CONTAINER_IMAGE
	string
	default "mx93a0-ahab-container.img" if BR2_PACKAGE_FIRMWARE_SENTINEL_MX93A0

endif
```

## package/freescale-imx/imx-linux-headers/Config.in
```kconfig
config BR2_PACKAGE_IMX_LINUX_HEADERS
	bool "imx-linux-headers"
	default y if BR2_PACKAGE_FREESCALE_IMX_GSTREAMER
	help
	  Installs i.MX-specific kernel headers to staging at
	  /usr/include/imx

	  Modified from bitbake recipe linux-imx-headers_5.4.3.bb
	  https://github.com/Freescale/meta-freescale.git
```

## package/go-native/Config.in.host
```kconfig
config BR2_PACKAGE_HOST_GO_NATIVE_ARCH_SUPPORTS
	bool
	# See https://go.dev/dl/ for supported architecture downloads
	default y if BR2_HOSTARCH = "x86"
	default y if BR2_HOSTARCH = "x86_64"
	default y if BR2_HOSTARCH = "arm"
	default y if BR2_HOSTARCH = "aarch64"

config BR2_PACKAGE_HOST_GO_NATIVE
	bool "host go-native"
	depends on BR2_PACKAGE_HOST_GO_NATIVE_ARCH_SUPPORTS
	default y if !BR2_PACKAGE_HOST_GO_BOOTSTRAP_ARCH_SUPPORTS
```

## package/libmodbuspp/Config.in
```kconfig
config BR2_PACKAGE_LIBMODBUSPP
	bool "libmodbuspp is C++ modbus library"
	depends on BR2_PACKAGE_LIBMODBUS
	help
	  libmodbuspp library for modbus

          https://github.com/epsilonrt/libmodbuspp.git
```

## package/libtappp/Config.in
```kconfig
config BR2_PACKAGE_LIBTAPPP
	bool "libtap++ C++ TAP producer library"
	help
		libtap++ - C++ unit tests for the Test Anything Protocol.

		libtap++ is a TAP producer for C++ programs.
```

## package/libwebsockets/Config.in
```kconfig
config BR2_PACKAGE_LIBWEBSOCKETS
	bool "libwebsockets"
	depends on !BR2_STATIC_LIBS
	select BR2_PACKAGE_ZLIB
	help
	  Libwebsockets is a lightweight pure C library built to use
	  minimal CPU and memory resources, and provide fast throughput
	  in both directions.

	  https://libwebsockets.org/

config BR2_PACKAGE_LIBWEBSOCKETS_NETLINK
	bool "enable netlink monitoring"
	default y
	help
	  libwebsockets will track link status with NETLINK
	  on Linux if avilable. Turn off to prevent potential
	  issues with IPv6 support.

config BR2_PACKAGE_LIBWEBSOCKETS_ASYNCDNS
	bool "enable async DNS resolution"
	default n
	help
	  Use nonblocking lws internal IPv4 + IPv6 DNS resolver

comment "libwebsockets needs a toolchain w/ dynamic library"
	depends on BR2_STATIC_LIBS
```

## package/networkd-dispatcher/Config.in
```kconfig
config BR2_PACKAGE_NETWORKD_DISPATCHER
	bool "networkd-dispatcher"
	depends on BR2_USE_MMU # python-gobject
	depends on BR2_USE_WCHAR # dbus-python
	depends on BR2_TOOLCHAIN_GCC_AT_LEAST_4_9 # python-gobject
	depends on BR2_TOOLCHAIN_HAS_THREADS # dbus-python
	depends on BR2_TOOLCHAIN_USES_GLIBC # python-gobject
	depends on BR2_PACKAGE_DBUS # dbus-python
	depends on BR2_PACKAGE_HOST_QEMU_ARCH_SUPPORTS # python-gobject
	depends on BR2_PACKAGE_PYTHON3 # runtime
	depends on BR2_PACKAGE_SYSTEMD_NETWORKD # runtime
	select BR2_PACKAGE_DBUS_PYTHON
	select BR2_PACKAGE_PYTHON_GOBJECT
	help
	  Networkd-dispatcher is a dispatcher daemon for
	  systemd-networkd connection status changes.
	  This daemon is similar to NetworkManager-dispatcher,
	  but is much more limited in the types of events it
	  supports due to the limited nature of systemd-networkd.

	  https://gitlab.com/craftyguy/networkd-dispatcher
```

## package/python-boto/Config.in
```kconfig
config BR2_PACKAGE_PYTHON_BOTO
	bool "python-boto"
	help
	  Amazon Web Services Library.

	  https://github.com/boto/boto/
```

## package/python-canopen/Config.in
```kconfig
config BR2_PACKAGE_PYTHON_CANOPEN
	bool "python-canopen"

	help
	  CanOpen module for python.

	  https://github.com/christiansandberg/canopen
```

## package/python-dbus-next/Config.in
```kconfig
config BR2_PACKAGE_PYTHON_DBUS_NEXT
	bool "python-dbus-next"
	depends on BR2_PACKAGE_PYTHON3
	help
	  The next great DBus library for Python

	  https://github.com/altdesktop/python-dbus-next
```

## package/python-defusedxml/Config.in
```kconfig
config BR2_PACKAGE_PYTHON_DEFUSEDXML
   bool "python-defusedxml"
   select BR2_PACKAGE_PYTHON_LXML

   help
      defusedxml python module
```

## package/python-fabric/Config.in
```kconfig
config BR2_PACKAGE_PYTHON_FABRIC
	bool "python-fabric"
	depends on BR2_PACKAGE_PYTHON_INVOKE
	depends on BR2_PACKAGE_PYTHON_PARAMIKO

	help
	  Fabric module for paramiko.

	  https://github.com/fabric/fabric
```

## package/python-hvac/Config.in
```kconfig
config BR2_PACKAGE_PYTHON_HVAC
	bool "python-hvac"
	select BR2_PACKAGE_PYTHON_REQUESTS
	select BR2_PACKAGE_PYTHON_SIX
	help
	  HashiCorp Vault API client.

	  https://github.com/hvac/hvac
```

## package/python-invoke/Config.in
```kconfig
config BR2_PACKAGE_PYTHON_INVOKE
	bool "python-invoke"
	help
	  invoke module for fabric.

	  https://pypi.org/project/invoke/
```

## package/python-isodate/Config.in
```kconfig
config BR2_PACKAGE_PYTHON_ISODATE
	bool "python-isodate"
	help
	  isodate python module
```

## package/python-jose/Config.in
```kconfig
config BR2_PACKAGE_PYTHON_JOSE
	bool "python-jose"
	help
	  jose module for python.
	  https://pypi.org/project/python-jose/
```

## package/python-labjack/Config.in
```kconfig
config BR2_PACKAGE_PYTHON_LABJACK
	bool "python-labjack"
	help
	  Labjack module for Python.

	  https://github.com/labjack/LabJackPython
```

## package/python-puresnmp-crypto/Config.in
```kconfig
config BR2_PACKAGE_PYTHON_PURESNMP_CRYPTO
    bool "python-puresnmp-crypto"
    help
      This package provides support for DES and AES encryption in puresnmp.

      https://pypi.org/project/puresnmp-crypto/
```

## package/python-puresnmp/Config.in
```kconfig
config BR2_PACKAGE_PYTHON_PURESNMP
    bool "python-puresnmp"
    select BR2_PACKAGE_PYTHON_X690 # runtime
    help
      This is a description of puresnmp.

      https://pypi.org/project/puresnmp/
```

## package/python-pykwalify/Config.in
```kconfig
config BR2_PACKAGE_PYTHON_PYKWALIFY
	bool "python-pykwalify"
	select BR2_PACKAGE_PYTHON_DATEUTIL # runtime
	select BR2_PACKAGE_PYTHON_DOCOPT # runtime
	select BR2_PACKAGE_PYTHON_RUAMEL_YAML # runtime
	help
	  Python lib/cli for JSON/YAML schema validation.

	  http://github.com/grokzen/pykwalify
```

## package/python-pyvisa-py/Config.in
```kconfig
config BR2_PACKAGE_PYTHON_PYVISA_PY
	bool "python-pyvisa-py"
	select BR2_PACKAGE_PYTHON_SERIAL
	select BR2_PYTHON_SETUPTOOLS_SCM
	help
	  Pure Python Visa module.

	  https://github.com/pyvisa/pyvisa-py
```

## package/python-qrcode/Config.in
```kconfig
config BR2_PACKAGE_PYTHON_QRCODE
	bool "python-qrcode"
	help
	  qrcode module for python.
	  https://pypi.org/project/qrcode/
```

## package/python-t61codec/Config.in
```kconfig
config BR2_PACKAGE_PYTHON_T61CODEC
    bool "python-t61codec"
    help
      This is a description of puresnmp.

      https://pypi.org/project/t61codec/
```

## package/python-visa/Config.in
```kconfig
config BR2_PACKAGE_PYTHON_VISA
	bool "python-visa"

	help
	  Visa module for python.

	  https://github.com/pyvisa/pyvisa
```
